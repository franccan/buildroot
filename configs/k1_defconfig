## configs/k1_defconfig
```kconfig
BR2_k1=y
BR2_TOOLCHAIN_BUILDROOT_WCHAR=y
BR2_TOOLCHAIN_BUILDROOT_CXX=y
BR2_PACKAGE_HOST_GDB=y
BR2_LINUX_KERNEL=y
BR2_LINUX_KERNEL_CUSTOM_TARBALL=y
BR2_LINUX_KERNEL_CUSTOM_TARBALL_LOCATION="$(call github,kalray,linux_coolidge,c609fd64dd6c3dc9a6f31c48087b7ed59a3d708e)/linux-c609fd64dd6c3dc9a6f31c48087b7ed59a3d708e.tar.gz"
BR2_LINUX_KERNEL_DEFCONFIG="default"
BR2_LINUX_KERNEL_CONFIG_FRAGMENT_FILES="board/k1/linux.fragment"
BR2_TARGET_ROOTFS_INITRAMFS=y
# BR2_TARGET_ROOTFS_TAR is not set
BR2_TARGET_BAREBOX=y
BR2_TARGET_BAREBOX_CUSTOM_TARBALL=y
BR2_TARGET_BAREBOX_CUSTOM_TARBALL_LOCATION="$(call github,kalray,barebox,631b4b14e489228ec3e580625055ebc9359cb9fb)/barebox-631b4b14e489228ec3e580625055ebc9359cb9fb.tar.gz"
BR2_TARGET_BAREBOX_BOARD_DEFCONFIG="generic"
```

## configs/libgbm_mesa3d_defconfig
```kconfig
BR2_arm=y
BR2_TOOLCHAIN_EXTERNAL=y
BR2_TOOLCHAIN_EXTERNAL_CUSTOM=y
BR2_TOOLCHAIN_EXTERNAL_DOWNLOAD=y
BR2_TOOLCHAIN_EXTERNAL_URL="http://autobuild.buildroot.org/toolchains/tarballs/br-arm-full-2018.05.tar.bz2"
BR2_TOOLCHAIN_EXTERNAL_GCC_4_9=y
BR2_TOOLCHAIN_EXTERNAL_HEADERS_4_1=y
BR2_TOOLCHAIN_EXTERNAL_LOCALE=y
# BR2_TOOLCHAIN_EXTERNAL_HAS_THREADS_DEBUG is not set
BR2_TOOLCHAIN_EXTERNAL_CXX=y
BR2_INIT_NONE=y
BR2_SYSTEM_BIN_SH_NONE=y
# BR2_PACKAGE_BUSYBOX is not set
BR2_PACKAGE_KMSCUBE=y
BR2_PACKAGE_MESA3D=y
BR2_PACKAGE_MESA3D_GALLIUM_DRIVER_SWRAST=y
BR2_PACKAGE_MESA3D_OPENGL_EGL=y
BR2_PACKAGE_MESA3D_OPENGL_ES=y
# BR2_TARGET_ROOTFS_TAR is not set
```

## configs/libgbm_sunxi_mali_defconfig
```kconfig
BR2_arm=y
BR2_cortex_a8=y
BR2_TOOLCHAIN_EXTERNAL=y
BR2_TOOLCHAIN_EXTERNAL_LINARO_ARM=y
BR2_INIT_NONE=y
BR2_SYSTEM_BIN_SH_NONE=y
# BR2_PACKAGE_BUSYBOX is not set
BR2_PACKAGE_KMSCUBE=y
BR2_PACKAGE_SUNXI_MALI_MAINLINE=y
BR2_PACKAGE_SUNXI_MALI_MAINLINE_OUTPUT_WAYLAND=y
BR2_PACKAGE_WAYLAND=y
# BR2_TARGET_ROOTFS_TAR is not set
```

## configs/libgbm_ti_sgx_defconfig
```kconfig
BR2_arm=y
BR2_cortex_a8=y
BR2_TOOLCHAIN_EXTERNAL=y
BR2_TOOLCHAIN_EXTERNAL_LINARO_ARM=y
BR2_INIT_NONE=y
BR2_ROOTFS_DEVICE_CREATION_DYNAMIC_EUDEV=y
BR2_SYSTEM_BIN_SH_NONE=y
# BR2_PACKAGE_BUSYBOX is not set
BR2_PACKAGE_KMSCUBE=y
BR2_PACKAGE_TI_SGX_UM=y
BR2_PACKAGE_EXPAT=y
BR2_PACKAGE_LIBXML2=y
BR2_PACKAGE_LIBFFI=y
# BR2_TARGET_ROOTFS_TAR is not set
```

## package/binutils/Config.in.host
```kconfig
comment "Binutils Options"

config BR2_PACKAGE_HOST_BINUTILS_SUPPORTS_CFI
	bool
	default y
	depends on !BR2_microblaze
	depends on !(BR2_nios2 && (BR2_BINUTILS_VERSION_2_28_X || BR2_BINUTILS_VERSION_2_29_X))

choice
	prompt "Binutils Version"
	default BR2_BINUTILS_VERSION_2_28_X if BR2_ARM_INSTRUCTIONS_THUMB
	default BR2_BINUTILS_VERSION_2_28_X if BR2_ARM_INSTRUCTIONS_THUMB2
	default BR2_BINUTILS_VERSION_2_29_X if !BR2_arc
	default BR2_BINUTILS_VERSION_ARC if BR2_arc
	default BR2_BINUTILS_VERSION_K1 if BR2_k1
	help
	  Select the version of binutils you wish to use.

config BR2_BINUTILS_VERSION_2_28_X
	bool "binutils 2.28.1"
	depends on !BR2_arc
	depends on !BR2_riscv
	depends on !BR2_k1

config BR2_BINUTILS_VERSION_2_29_X
	bool "binutils 2.29.1"
	depends on !BR2_riscv
	depends on !BR2_k1

config BR2_BINUTILS_VERSION_2_30_X
	bool "binutils 2.30"
	depends on !BR2_k1

config BR2_BINUTILS_VERSION_2_31_X
	bool "binutils 2.31.1"
	depends on !BR2_k1

config BR2_BINUTILS_VERSION_ARC
	bool "binutils arc (2.31)"
	depends on BR2_arc

config BR2_BINUTILS_VERSION_K1
	bool "binutils k1"
	depends on BR2_k1

endchoice

config BR2_BINUTILS_VERSION
	string
	default "arc-2018.09-release"	if BR2_BINUTILS_VERSION_ARC
	default "c725216fff1e77b2c77a73f5729bd727257719fd" if BR2_BINUTILS_VERSION_K1
	default "2.28.1"	if BR2_BINUTILS_VERSION_2_28_X
	default "2.29.1"	if BR2_BINUTILS_VERSION_2_29_X
	default "2.30"		if BR2_BINUTILS_VERSION_2_30_X
	default "2.31.1"	if BR2_BINUTILS_VERSION_2_31_X

config BR2_BINUTILS_ENABLE_LTO
	bool

config BR2_BINUTILS_EXTRA_CONFIG_OPTIONS
	string "Additional binutils options"
	default ""
	help
	  Any additional binutils options you may want to include.
```

## package/ti-sgx-km/Config.in
```kconfig
comment "ti-sgx-km needs a Linux kernel to be built"
	depends on BR2_arm
	depends on !BR2_LINUX_KERNEL

config BR2_PACKAGE_TI_SGX_KM
	bool "ti-sgx-km"
	depends on BR2_LINUX_KERNEL && BR2_arm
	select BR2_LINUX_NEEDS_MODULES
	help
	  Kernel modules for TI CPUs with SGX GPU.
	  This package supports AM33xx, AM43xx and AM57xx.
	  It builds the kernel module and the user space binaries.
	  For older CPUs or kernels use the ti-gfx package.

	  Note: it needs a TI specific kernel to build properly.

	  http://git.ti.com/graphics/omap5-sgx-ddk-linux

if BR2_PACKAGE_TI_SGX_KM

choice
	prompt "Target"
	default BR2_PACKAGE_TI_SGX_KM_AM335X if BR2_PACKAGE_TI_SGX_AM335X # legacy
	default BR2_PACKAGE_TI_SGX_KM_AM437X if BR2_PACKAGE_TI_SGX_AM437X # legacy
	default BR2_PACKAGE_TI_SGX_KM_AM437X if BR2_PACKAGE_TI_SGX_AM4430    # legacy
	default BR2_PACKAGE_TI_SGX_KM_AM437X if BR2_PACKAGE_TI_SGX_KM_AM4430 # legacy
	default BR2_PACKAGE_TI_SGX_KM_AM57X  if BR2_PACKAGE_TI_SGX_AM5430    # legacy
	default BR2_PACKAGE_TI_SGX_KM_AM57X  if BR2_PACKAGE_TI_SGX_KM_AM5430 # legacy
	default BR2_PACKAGE_TI_SGX_KM_AM335X
	help
	  Select the SOC for which you would like to install drivers.

config BR2_PACKAGE_TI_SGX_KM_AM335X
	bool "AM335x"
	help
	  All AM33xx derivatives

config BR2_PACKAGE_TI_SGX_KM_AM437X
	bool "AM437x"
	help
	  All AM43xx derivatives

config BR2_PACKAGE_TI_SGX_KM_AM57X
	bool "AM57x"
	help
	  All DRA7xx / AM57xx derivatives

endchoice

endif
```

## package/ti-sgx-libgbm/Config.in
```kconfig
config BR2_PACKAGE_TI_SGX_LIBGBM
	bool "ti-sgx-libgbm"
	depends on BR2_PACKAGE_HAS_UDEV
	depends on BR2_TOOLCHAIN_HAS_THREADS # libdrm
	select BR2_PACKAGE_LIBDRM
	select BR2_PACKAGE_HAS_LIBGBM
	help
	  This package provides libgbm.so.2 for the
	  TI SGX implementation

	  https://git.ti.com/glsdk/libgbm

comment "ti-sgx-libgbm needs udev and a toolchain w/ thread"
	depends on !BR2_PACKAGE_HAS_UDEV || !BR2_TOOLCHAIN_HAS_THREADS

if BR2_PACKAGE_TI_SGX_LIBGBM

config BR2_PACKAGE_PROVIDES_LIBGBM
	default "ti-sgx-libgbm"

endif
```

## package/ti-sgx-um/Config.in
```kconfig
comment "ti-sgx-um needs udev /dev management and a glibc toolchain w/ threads"
	depends on !BR2_TOOLCHAIN_USES_GLIBC || !BR2_TOOLCHAIN_HAS_THREADS \
		|| !BR2_PACKAGE_HAS_UDEV

config BR2_PACKAGE_TI_SGX_UM
	bool "ti-sgx-um"
	depends on BR2_TOOLCHAIN_HAS_THREADS # libdrm
	# pre-built binaries
	depends on BR2_TOOLCHAIN_USES_GLIBC
	depends on BR2_PACKAGE_HAS_UDEV # ti-sgx-libgbm
	select BR2_PACKAGE_LIBDRM
	select BR2_PACKAGE_LIBDRM_OMAP
	select BR2_PACKAGE_HAS_LIBEGL
	select BR2_PACKAGE_HAS_LIBGLES
	select BR2_PACKAGE_HAS_POWERVR
	select BR2_PACKAGE_TI_SGX_LIBGBM
	help
	  Graphics libraries for TI CPUs with SGX5xx GPU.
	  This package supports AM33xx, AM43xx and AM54xx.
	  For older CPUs or kernels use the ti-gfx package.

	  http://git.ti.com/graphics/omap5-sgx-ddk-um-linux

if BR2_PACKAGE_TI_SGX_UM

config BR2_PACKAGE_PROVIDES_LIBEGL
	default "ti-sgx-um"

config BR2_PACKAGE_PROVIDES_LIBGLES
	default "ti-sgx-um"

config BR2_PACKAGE_PROVIDES_POWERVR
	default "ti-sgx-um"

endif
```

## toolchain/toolchain-external/toolchain-external-bootlin/Config.in
```kconfig
config BR2_TOOLCHAIN_EXTERNAL_BOOTLIN
	bool "Bootlin 2018.02"
	depends on BR2_TOOLCHAIN_EXTERNAL_BOOTLIN_ARCH != ""
	depends on BR2_HOSTARCH = "x86_64"
	select BR2_INSTALL_LIBSTDCPP
	select BR2_TOOLCHAIN_HAS_SSP
	help
	  Bootlin toolchains are built using Buildroot for a large
	  number of architectures and C libraries configurations.

	  https://toolchains.bootlin.com
```
